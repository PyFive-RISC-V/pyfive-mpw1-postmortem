/*
 * demo-pdm.S
 *
 * Firmware for testing the PDM output hardware and its FIFO.
 * It pushes out about 8 kSps and generates a sine wave on one
 * channel and a triangle wave on the other channel.
 *
 * Copyright (C) 2021-2022  Sylvain Munaut <tnt@246tNt.com>
 * SPDX-License-Identifier: MIT
 */

#define IOCONF_BASE	0x26000000
#define IOCONF_OFS(x)	(0x20 + 4 * (x))(a0)

	.section .text.start
	.global _start
_start:
	// Set configuration
	li a0, IOCONF_BASE

	// Clear all registers
	li a1, 0x26000020
	li a2, 0x260000b8

1:
	nop
	sw zero, 0(a1)
	addi    a1, a1, 4
	bne	a1, a2, 1b

	// Auto ---
	li s3, 0x0100
	sw s3, IOCONF_OFS(18)
	li s3, 0x0218
	sw s3, IOCONF_OFS(19)
	li s3, 0x0030
	sw s3, IOCONF_OFS(20)

	// Trigger load
	li s0, 1
	sw s0, 0(a0)

1:
	lw s0, 0(a0)
	bne s0, zero, 1b


	// Copy data table to SRAM
	la a0, data
	la a1, data_end
	li a2, 0x30400000
1:
	nop
	lw s0, 0(a0)
	sw s0, 0(a2)
	addi a0, a0, 4
	addi a2, a2, 4
	bne a0, a1, 1b

	// Audio init
	li a0, 0x30200000

	li s0, 1
	sw s0, 0(a0)		// Run

	li s0, 669-2
	sw s0, 4(a0)		// Div (669 -> ~ 9.4 kHz)

	li s0, 0x7fff7fff
	sw s0, 8(a0)		// Volume

	// a0 = Audio base
	// a1 = Data base
	// a2 = Compute index
	// s0 = Accumulator
	// s1 = Data word

	li a1, 0x30400000
	li s0, 0

1:
	nop

	// Wait for space in FIFO
	lb s2, 1(a0)
	bne s2, zero, 1b

	// Load and write data
	add a2, a1, s0
	lw  s1,  0(a2)
	sw  s1, 12(a0)

	// Next word
	addi s0, s0, 6*4
	andi s0, s0, 0x1fc

	// Loop
	j 1b

data:
	.word 0x00008001
	.word 0x06488401
	.word 0x0c8c8801
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	.word 0xf9b88401
data_end:
